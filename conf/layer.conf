## conf/layer.conf
```bitbake
BBPATH .= ":${LAYERDIR}"
BBFILES += "${LAYERDIR}/recipes-*/*/*.bb             ${LAYERDIR}/recipes-*/*/*.bbappend"

BBFILE_COLLECTIONS += "snow"
BBFILE_PATTERN_snow = "^${LAYERDIR}/"
BBFILE_PRIORITY_snow = "10"
LAYERSERIES_COMPAT_snow = "nanbield"
```
